## host/ns2/kernel/git/Documentation/devicetree/bindings/net/broadcom-bcm848x.txt
```
The Broadcom BCM87XX devices are a family of 10G Ethernet PHYs.  They
have these bindings in addition to the standard PHY bindings.

Compatible: Should contain "broadcom,bcm8706" or "broadcom,bcm8727" and
            "ethernet-phy-ieee802.3-c45"

Optional Properties:

- broadcom,c45-reg-init : one of more sets of 4 cells.  The first cell
  is the MDIO Manageable Device (MMD) address, the second a register
  address within the MMD, the third cell contains a mask to be ANDed
  with the existing register value, and the fourth cell is ORed with
  he result to yield the new register value.  If the third cell has a
  value of zero, no read of the existing value is performed.

Example:

        ext10gphy0: eth-phy@1E {
                 compatible = "ethernet-phy-idAE02.5040",
                              "ethernet-phy-ieee802.3-c45";
                 reg = <0x1E>;
	};
```

## host/ns2/u-boot/git/arch/arm/mach-iproc/Kconfig
```kconfig
if ARCH_IPROC

config NS2
	bool "NORTHSTAR2 family"
	select ARM64

source "arch/arm/mach-iproc/ns2/Kconfig"

endif
```

## host/ns2/u-boot/git/arch/arm/mach-iproc/ns2/Kconfig
```kconfig
if NS2

choice
	prompt "NORTHSTAR2 board select"
	optional

config TARGET_NS2_SVK
	bool "Broadcom Northstar2 SVK board"

config TARGET_NS2_XMC
	bool "Broadcom Northstar2 XMC board"

endchoice

config SYS_SOC
	default "ns2"

source "board/broadcom/bcmns2_svk/Kconfig"

endif
```

## host/ns2/u-boot/git/board/broadcom/bcm_pegasus/Kconfig
```kconfig
if TARGET_BROADCOM_PEGASUS

config SYS_BOARD
	default "bcm_pegasus"

config SYS_VENDOR
	default "broadcom"

config SYS_SOC
    default "bcm_pegasus"

config SYS_CONFIG_NAME
	default "bcm_pegasus"

endif
```

## host/ns2/u-boot/git/board/broadcom/bcmns2_svk/Kconfig
```kconfig
if TARGET_NS2_SVK

config SYS_BOARD
	default "bcmns2_svk"

config SYS_VENDOR
	default "broadcom"

config SYS_CONFIG_NAME
	default "bcm_northstar2"
endif
```

## host/ns2/u-boot/git/configs/northstar2_defconfig
```kconfig
CONFIG_ARM=y
CONFIG_ARCH_IPROC=y
CONFIG_NS2=y
CONFIG_TARGET_NS2_SVK=y
CONFIG_SYS_PROMPT="u-boot> "
CONFIG_CMD_USB=y
CONFIG_CMD_I2C=y
CONFIG_SYS_EXTRA_OPTIONS="BCM_NS2_CHIMP"
CONFIG_CMD_NET=y
CONFIG_CMD_TFTPPUT=y
CONFIG_CMD_DHCP=y
CONFIG_CMD_PING=y
CONFIG_CMD_NFS=y
CONFIG_CMD_FS_GENERIC=y
```

## host/ns2/u-boot/git/configs/pegasus_defconfig
```kconfig
CONFIG_ARM=y
CONFIG_TARGET_BROADCOM_PEGASUS=y
CONFIG_SYS_EXTRA_OPTIONS="ARM64"
CONFIG_SYS_GENERIC_BOARD=y
CONFIG_SYS_PROMPT="u-boot> "
```
